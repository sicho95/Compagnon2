## sdkconfig.defaults.esp32s3
```kconfig
# Compagnon2 sdkconfig defaults — ESP32-S3 16MB Flash / 8MB OPI PSRAM

# CPU
CONFIG_ESP32S3_DEFAULT_CPU_FREQ_240=y

# Flash
CONFIG_ESPTOOLPY_FLASHSIZE_16MB=y
CONFIG_ESPTOOLPY_FLASHSIZE="16MB"
CONFIG_PARTITION_TABLE_CUSTOM=y
CONFIG_PARTITION_TABLE_CUSTOM_FILENAME="partitions/compagnon2.csv"

# PSRAM — OPI 8MB 80MHz
CONFIG_ESP32S3_SPIRAM_SUPPORT=y
CONFIG_SPIRAM_MODE_OCT=y
CONFIG_SPIRAM_SPEED_80M=y
CONFIG_SPIRAM_FETCH_INSTRUCTIONS=y
CONFIG_SPIRAM_RODATA=y
CONFIG_SPIRAM_TRY_ALLOCATE_WIFI_LWIP=y

# LVGL buffers en PSRAM
CONFIG_LV_MEM_SIZE_KILOBYTES=512

# FreeRTOS
CONFIG_FREERTOS_HZ=1000
CONFIG_FREERTOS_UNICORE=n

# Log level
CONFIG_LOG_DEFAULT_LEVEL_INFO=y

# BLE
CONFIG_BT_ENABLED=y
CONFIG_BT_BLE_ENABLED=y
CONFIG_BTDM_CTRL_MODE_BLE_ONLY=y

# WiFi
CONFIG_ESP_WIFI_STATIC_RX_BUFFER_NUM=4
CONFIG_ESP_WIFI_DYNAMIC_RX_BUFFER_NUM=8

# HTTPS / TLS (pour Groq API)
CONFIG_ESP_TLS_USING_MBEDTLS=y
CONFIG_MBEDTLS_CERTIFICATE_BUNDLE=y
CONFIG_MBEDTLS_CERTIFICATE_BUNDLE_DEFAULT_CMN=y

# OTA
CONFIG_BOOTLOADER_APP_ROLLBACK_ENABLE=y

# USB CDC (upload + monitor)
CONFIG_ESP_CONSOLE_USB_CDC=y

# Compagnon2 — Groq LLM Configuration
CONFIG_COMPAGNON_LLM_PROVIDER="groq"
CONFIG_COMPAGNON_LLM_MODEL="llama-3.3-70b-versatile"
CONFIG_COMPAGNON_LLM_MODEL_FAST="llama-3.1-8b-instant"
CONFIG_COMPAGNON_LLM_URL="https://api.groq.com/openai/v1/chat/completions"
CONFIG_COMPAGNON_ASR_URL="https://api.groq.com/openai/v1/audio/transcriptions"
CONFIG_COMPAGNON_ASR_MODEL="whisper-large-v3"
CONFIG_COMPAGNON_TTS_URL="https://api.groq.com/openai/v1/audio/speech"
CONFIG_COMPAGNON_TTS_MODEL="playai-tts"
CONFIG_COMPAGNON_TTS_VOICE="Fritz-PlayAI"
```
